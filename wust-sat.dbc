VERSION "0.1.0"

NS_ :

BS_:

BU_:

BO_ 2147549171 LORA_Heartbeat: 4 LORA
 SG_ unix_timestamp : 0|32@1+ (1,0) [0|0] "s" Vector__XXX

BO_ 2147549180 OBC_CM_Heartbeat: 4 OBC_CM
 SG_ unix_timestamp : 0|32@1+ (1,0) [0|0] "s" Vector__XXX

CM_ BO_ 2147549171 "Heartbeat from LoRa Communication System";
CM_ SG_ 2147549171 unix_timestamp "Unix timestamp in seconds";
CM_ BO_ 2147549180 "Heartbeat from On-Board Computer Compute Module";
CM_ SG_ 2147549180 unix_timestamp "Unix timestamp in seconds";
