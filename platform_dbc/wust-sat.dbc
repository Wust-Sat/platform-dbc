VERSION ""

NS_ :

BS_:

BU_:

BO_ 17 COMM_Heartbeat: 4 COMM
 SG_ unix_timestamp : 0|32@1+ (1,0) [0|0] "s" Vector__XXX

BO_ 97 OBC_Heartbeat: 4 OBC
 SG_ unix_timestamp : 0|32@1+ (1,0) [0|0] "s" Vector__XXX

CM_ BO_ 17 "Heartbeat from UHF Communication System";
CM_ SG_ 17 unix_timestamp "Unix timestamp in seconds";
CM_ BO_ 97 "Heartbeat from On-Board Computer Compute Module";
CM_ SG_ 97 unix_timestamp "Unix timestamp in seconds";
